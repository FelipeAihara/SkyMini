## boards/custom/esp32c6_supermini/Kconfig.esp32c6_supermini
```kconfig
config BOARD_ESP32C6_SUPERMINI
	select SOC_ESP32C6
	select SOC_ESP32C6_HPCORE if BOARD_ESP32C6_SUPERMINI_ESP32C6_HPCORE
```

## boards/custom/esp32c6_supermini/board.yml
```yaml
board:
  name: esp32c6_supermini
  full_name: ESP32-C6-SUPERMINI
  vendor: custom
  socs:
    - name: esp32c6
```
